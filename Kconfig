## lib/Kconfig
```kconfig
menu "Libraries"

rsource "gtp_buttons/Kconfig"
rsource "gtp_display/Kconfig"
rsource "gtp_game/Kconfig"
rsource "gtp_memory_game/Kconfig"
rsource "gtp_menu/Kconfig"
rsource "gtp_reactivity_game/Kconfig"
rsource "gtp_simple_sound_game/Kconfig"
rsource "gtp_traffic_game/Kconfig"

endmenu
```

## lib/gtp_buttons/Kconfig
```kconfig
config GTP_BUTTONS
	bool "enable gtp buttons library"
	default n
	help
	  enable gtp buttons library

if GTP_BUTTONS

module = GTPBUTTONS
module-str = gtp_buttons
source "subsys/logging/Kconfig.template.log_config"

endif # GTP_BUTTONS
```

## lib/gtp_display/Kconfig
```kconfig
config GTP_DISPLAY
	bool "enable gtp display library"
	default n
	help
	  enable gtp display library

if GTP_DISPLAY

module = GTPDISPLAY
module-str = gtp_display
source "subsys/logging/Kconfig.template.log_config"

endif # GTP_DISPLAY
```

## lib/gtp_dual_speed_game/Kconfig
```kconfig
config GTP_DUAL_SPEED_GAME
	bool "enable gtp dual speed game"
	default n
	select TEST_RANDOM_GENERATOR
	select GTP_BUTTONS
	select GTP_DISPLAY
	help
	  enable gtp dual speed game

if GTP_DUAL_SPEED_GAME

module = GTPDUALSPEEDGAME
module-str = gtp_dual_speed_game
source "subsys/logging/Kconfig.template.log_config"

endif # GTP_GAME
```

## lib/gtp_game/Kconfig
```kconfig
config GTP_GAME
	bool "enable gtp game generic tools"
	default n
	select TEST_RANDOM_GENERATOR
	select GTP_BUTTONS
	select GTP_DISPLAY
	help
	  enable gtp game generic tools

if GTP_GAME

module = GTPGAME
module-str = gtp_game
source "subsys/logging/Kconfig.template.log_config"

endif # GTP_GAME
```

## lib/gtp_memory_game/Kconfig
```kconfig
config GTP_MEMORY_GAME
	bool "enable gtp memory game"
	default n
	select GTP_GAME
	select GTP_BUTTONS
	select GTP_DISPLAY
	select GTP_SOUND
	help
	  enable gtp memory game

if GTP_MEMORY_GAME

module = GTPMEMORYGAME
module-str = gtp_memory_game
source "subsys/logging/Kconfig.template.log_config"

endif # GTP_MEMORY_GAME
```

## lib/gtp_menu/Kconfig
```kconfig
config GTP_MENU
	bool "enable gtp menu"
	default n
	help
	  enable gtp menu library

if GTP_MENU

module = GTPMENU
module-str = gtp_menu
source "subsys/logging/Kconfig.template.log_config"

endif # GTP_MENU
```

## lib/gtp_reactivity_game/Kconfig
```kconfig
config GTP_REACTIVITY_GAME
	bool "enable gtp reactivity game"
	default n
	select GTP_BUTTONS
	select GTP_DISPLAY
	select TEST_RANDOM_GENERATOR
	help
	  enable gtp reactivity game

if GTP_REACTIVITY_GAME

module = GTPREACTIVITYGAME
module-str = gtp_reactivity_game
source "subsys/logging/Kconfig.template.log_config"

endif # GTP_REACTIVITY_GAME
```

## lib/gtp_simple_sound_game/Kconfig
```kconfig
config GTP_SIMPLE_SOUND_GAME
	bool "enable gtp simple sound game"
	default n
	select GTP_GAME
	select GTP_BUTTONS
	select GTP_DISPLAY
    select PWM
	help
	  enable gtp sound game

if GTP_SIMPLE_SOUND_GAME

module = GTPSIMPLESOUNDGAME
module-str = gtp_simple_sound_game
source "subsys/logging/Kconfig.template.log_config"

endif # GTP_SIMPLE_SOUND_GAME
```

## lib/gtp_sound/Kconfig
```kconfig
config GTP_SOUND
	bool "enable gtp sound"
	default n
    select PWM
	select GTP_GAME
	help
	  enable gtp sound library

if GTP_SOUND

module = GTPSOUND
module-str = gtp_sound
source "subsys/logging/Kconfig.template.log_config"

endif # GTP_GTP_SOUND
```

## lib/gtp_traffic_escape_game/Kconfig
```kconfig
config GTP_TRAFFIC_ESCAPE_GAME
	bool "enable gtp simple sound game"
	default n
	select GTP_GAME
	select GTP_BUTTONS
	select GTP_DISPLAY
    select PWM
	help
	  enable gtp traffic escape game

if GTP_TRAFFIC_ESCAPE_GAME

module = GTPTRAFFICESCAPEGAME
module-str = gtp_traffic_escape_game
source "subsys/logging/Kconfig.template.log_config"

endif # GTP_TRAFFIC_ESCAPE_GAME
```

## lib/gtp_traffic_game/Kconfig
```kconfig
config GTP_TRAFFIC_GAME
	bool "enable gtp traffic game"
	default n
	select GTP_GAME
	select GTP_BUTTONS
	select GTP_DISPLAY
	select GTP_SOUND
	help
	  enable gtp traffic game

if GTP_TRAFFIC_GAME

module = GTPTRAFFICGAME
module-str = gtp_traffic_game
source "subsys/logging/Kconfig.template.log_config"

endif # GTP_TRAFFIC_GAME
```

## west.yml
```yaml
west:
  url: https://github.com/zephyrproject-rtos/west
  version: v0.8.0

manifest:
  self:
    path: gametoy
  defaults:
    remote: zephyr
  remotes:
    - name: zephyr
      url-base: https://github.com/zephyrproject-rtos
    - name: github
      url-base: git@github.com:adri1mart1
  projects:
    - name: zephyr
      remote: zephyr
      revision: v3.7.0
      import:
        name-allowlist:
          - segger
          - hal_nordic
          - hal_st
          - hal_stm32
          - cmsis
      west-commands: scripts/west-commands.yml
```
