## CMakeLists.txt
```
# SPDX-License-Identifier: Apache-2.0

cmake_minimum_required(VERSION 3.20.0)
find_package(Zephyr REQUIRED HINTS $ENV{ZEPHYR_BASE})
project(gtp_reactivity_game_test)

target_sources(app PRIVATE src/main.c)
```

## prj.conf
```kconfig
CONFIG_GTP_REACTIVITY_GAME=y
CONFIG_LOG=y
CONFIG_GTPREACTIVITYGAME_LOG_LEVEL_DBG=y
```

## src/main.c
```c
#include <gtp_reactivity_game.h>
#include <gtp_buttons.h>
#include <zephyr/kernel.h>

int main()
{
	gtp_buttons_init();
	gtp_reactivity_game_start();

	while (1) {
		k_msleep(1000);
	}
}
```
